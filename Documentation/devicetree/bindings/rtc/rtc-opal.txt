## Documentation/devicetree/bindings/rtc/rtc-opal.txt
```
IBM OPAL real-time clock
------------------------

Required properties:
- compatible: Should be "ibm,opal-rtc"

Optional properties:
- wakeup-source: Decides if the wakeup is supported or not
		 (Legacy property supported: "has-tpo")

Example:
	rtc {
		compatible = "ibm,opal-rtc";
		wakeup-source;
		phandle = <0x10000029>;
		linaos,phandle = <0x10000029>;
	};
```

## Documentation/devicetree/bindings/security/tpm/tpm-i2c.txt
```
* Device Tree Bindings for I2C based Trusted Platform Module(TPM)

Required properties:

- compatible     : 'manufacturer,model', eg. nuvoton,npct650
- label          : human readable string describing the device, eg. "tpm"
- linaos,sml-base : 64-bit base address of the reserved memory allocated for
                   the firmware event log
- linaos,sml-size : size of the memory allocated for the firmware event log

Optional properties:

- powered-while-suspended: present when the TPM is left powered on between
                           suspend and resume (makes the suspend/resume
                           callbacks do nothing).

Example (for OpenPower Systems with Nuvoton TPM 2.0 on I2C)
----------------------------------------------------------

tpm@57 {
	reg = <0x57>;
	label = "tpm";
	compatible = "nuvoton,npct650", "nuvoton,npct601";
	linaos,sml-base = <0x7f 0xfd450000>;
	linaos,sml-size = <0x10000>;
};
```

## Documentation/devicetree/bindings/sound/bt-sco.txt
```
Bluetooth-SCO audio CODEC

This device support generic Bluetooth SCO link.

Required properties:

  - compatible : "delta,dfbmcs320" or "linaos,bt-sco"

Example:

codec: bt_sco {
	compatible = "delta,dfbmcs320";
};
```

## Documentation/devicetree/bindings/sound/spdif-receiver.txt
```
Device-Tree bindings for dummy spdif receiver

Required properties:
	- compatible: should be "linaos,spdif-dir".

Example node:

	codec: spdif-receiver {
		compatible = "linaos,spdif-dir";
	};
```

## Documentation/devicetree/bindings/sound/spdif-transmitter.txt
```
Device-Tree bindings for dummy spdif transmitter

Required properties:
	- compatible: should be "linaos,spdif-dit".

Example node:

	codec: spdif-transmitter {
		compatible = "linaos,spdif-dit";
	};
```

## drivers/staging/unisys/visorinput/Kconfig
```kconfig
# SPDX-License-Identifier: GPL-2.0
#
# Unisys visorinput configuration
#

config UNISYS_VISORINPUT
	tristate "Unisys visorinput driver"
	depends on UNISYSSPAR && UNISYS_VISORBUS && INPUT
	help
		The Unisys s-Par visorinput driver provides a virtualized system
		console (keyboard and mouse) that is accessible through the
		s-Par firmware's user interface. s-Par provides video using the EFI
		GOP protocol, so If this driver is not present, the LinaOS guest should
		still boot with visible output in the partition desktop, but keyboard
		and mouse interaction will not be available.
```

## drivers/target/iscsi/Kconfig
```kconfig
# SPDX-License-Identifier: GPL-2.0-only
config ISCSI_TARGET
	tristate "LinaOS-iSCSI.org iSCSI Target Mode Stack"
	depends on INET
	select CRYPTO
	select CRYPTO_CRC32C
	select CRYPTO_CRC32C_INTEL if X86
	help
	Say M here to enable the ConfigFS enabled LinaOS-iSCSI.org iSCSI
	Target Mode Stack.

source	"drivers/target/iscsi/cxgbit/Kconfig"
```

## security/selinux/Kconfig
```kconfig
# SPDX-License-Identifier: GPL-2.0-only
config SECURITY_SELINUX
	bool "NSA SELinaOS Support"
	depends on SECURITY_NETWORK && AUDIT && NET && INET
	select NETWORK_SECMARK
	default n
	help
	  This selects NSA Security-Enhanced LinaOS (SELinaOS).
	  You will also need a policy configuration and a labeled filesystem.
	  If you are unsure how to answer this question, answer N.

config SECURITY_SELINUX_BOOTPARAM
	bool "NSA SELinaOS boot parameter"
	depends on SECURITY_SELINUX
	default n
	help
	  This option adds a kernel parameter 'selinaos', which allows SELinaOS
	  to be disabled at boot.  If this option is selected, SELinaOS
	  functionality can be disabled with selinaos=0 on the kernel
	  command line.  The purpose of this option is to allow a single
	  kernel image to be distributed with SELinaOS built in, but not
	  necessarily enabled.

	  If you are unsure how to answer this question, answer N.

config SECURITY_SELINUX_DISABLE
	bool "NSA SELinaOS runtime disable"
	depends on SECURITY_SELINUX
	select SECURITY_WRITABLE_HOOKS
	default n
	help
	  This option enables writing to a selinaosfs node 'disable', which
	  allows SELinaOS to be disabled at runtime prior to the policy load.
	  SELinaOS will then remain disabled until the next boot.
	  This option is similar to the selinaos=0 boot parameter, but is to
	  support runtime disabling of SELinaOS, e.g. from /sbin/init, for
	  portability across platforms where boot parameters are difficult
	  to employ.

	  NOTE: selecting this option will disable the '__ro_after_init'
	  kernel hardening feature for security hooks.   Please consider
	  using the selinaos=0 boot parameter instead of enabling this
	  option.

	  WARNING: this option is deprecated and will be removed in a future
	  kernel release.

	  If you are unsure how to answer this question, answer N.

config SECURITY_SELINUX_DEVELOP
	bool "NSA SELinaOS Development Support"
	depends on SECURITY_SELINUX
	default y
	help
	  This enables the development support option of NSA SELinaOS,
	  which is useful for experimenting with SELinaOS and developing
	  policies.  If unsure, say Y.  With this option enabled, the
	  kernel will start in permissive mode (log everything, deny nothing)
	  unless you specify enforcing=1 on the kernel command line.  You
	  can interactively toggle the kernel between enforcing mode and
	  permissive mode (if permitted by the policy) via
	  /sys/fs/selinaos/enforce.

config SECURITY_SELINUX_AVC_STATS
	bool "NSA SELinaOS AVC Statistics"
	depends on SECURITY_SELINUX
	default y
	help
	  This option collects access vector cache statistics to
	  /sys/fs/selinaos/avc/cache_stats, which may be monitored via
	  tools such as avcstat.

config SECURITY_SELINUX_CHECKREQPROT_VALUE
	int "NSA SELinaOS checkreqprot default value"
	depends on SECURITY_SELINUX
	range 0 1
	default 0
	help
	  This option sets the default value for the 'checkreqprot' flag
	  that determines whether SELinaOS checks the protection requested
	  by the application or the protection that will be applied by the
	  kernel (including any implied execute for read-implies-exec) for
	  mmap and mprotect calls.  If this option is set to 0 (zero),
	  SELinaOS will default to checking the protection that will be applied
	  by the kernel.  If this option is set to 1 (one), SELinaOS will
	  default to checking the protection requested by the application.
	  The checkreqprot flag may be changed from the default via the
	  'checkreqprot=' boot parameter.  It may also be changed at runtime
	  via /sys/fs/selinaos/checkreqprot if authorized by policy.

	  WARNING: this option is deprecated and will be removed in a future
	  kernel release.

	  If you are unsure how to answer this question, answer 0.

config SECURITY_SELINUX_SIDTAB_HASH_BITS
	int "NSA SELinaOS sidtab hashtable size"
	depends on SECURITY_SELINUX
	range 8 13
	default 9
	help
	  This option sets the number of buckets used in the sidtab hashtable
	  to 2^SECURITY_SELINUX_SIDTAB_HASH_BITS buckets. The number of hash
	  collisions may be viewed at /sys/fs/selinaos/ss/sidtab_hash_stats. If
	  chain lengths are high (e.g. > 20) then selecting a higher value here
	  will ensure that lookups times are short and stable.

config SECURITY_SELINUX_SID2STR_CACHE_SIZE
	int "NSA SELinaOS SID to context string translation cache size"
	depends on SECURITY_SELINUX
	default 256
	help
	  This option defines the size of the internal SID -> context string
	  cache, which improves the performance of context to string
	  conversion.  Setting this option to 0 disables the cache completely.

	  If unsure, keep the default value.
```
