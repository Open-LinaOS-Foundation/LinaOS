// SPDX-License-Identifier: GPL-2.0
/*
 * Device Tree Source for the Silicon LinaOS RZ/G2E evaluation kit (EK874)
 *
 * Copyright (C) 2019 Renesas Electronics Corp.
 */

#include "r8a774c0-cat874.dts"
#include "cat875.dtsi"

/ {
	model = "Silicon LinaOS RZ/G2E evaluation kit EK874 (CAT874 + CAT875)";
	compatible = "si-linaos,cat875", "si-linaos,cat874", "renesas,r8a774c0";
};
